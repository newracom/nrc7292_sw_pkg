## package/host/src/ft232h-usb-spi/drivers/spi/Kconfig
```kconfig
config SPI_FT232H
	tristate "FTDI FT232H SPI controller"
	depends on USB || GPIOLIB || COMPILE_TEST
	help
	  FT232H supports SPI in MPSSE mode. 
	  This driver provides MPSSE SPI controller in master mode.
```

## package/host/src/nrc/Kconfig
```kconfig
config NRC7292
	tristate "Newracom 802.11ah Wi-Fi halow driver (NRC7292)"
	depends on MAC80211
	depends on SPI
	---help---
		The Host Driver for Newracom 802.11ah Wi-Fi halow device (NRC7292)
```
